#include <td-bindings/zmk/matrix_transform.h>

/ {
  chosen {
    zmk,kscan = &default_kscan
    zmk,matrix_transform = &default_transform
  };
  default_kscan: kscan {
        compatible = "zmk,kscan-gpio-matrix";
        diode-direction = "col2row";
        wakeup-source;
        col-gpios = 
            <&pro_micro  7 (GPIO_ACTIVE_HIGH)>,
            <&pro_micro  8 (GPIO_ACTIVE_HIGH)>,
            <&pro_micro  9 (GPIO_ACTIVE_HIGH)>,
            <&pro_micro 18 (GPIO_ACTIVE_HIGH)>,
            <&pro_micro 19 (GPIO_ACTIVE_HIGH)>,
            <&pro_micro 20 (GPIO_ACTIVE_HIGH)>;
        row-gpios = 
            <&pro_micro 10 (GPIO_ACTIVE_HIGH | GPIO_PULL_DOWN)>,
            <&pro_micro 16 (GPIO_ACTIVE_HIGH | GPIO_PULL_DOWN)>,
            <&pro_micro 14 (GPIO_ACTIVE_HIGH | GPIO_PULL_DOWN)>,
            <&pro_micro 15 (GPIO_ACTIVE_HIGH | GPIO_PULL_DOWN)>;

  };
  default_transform: matrix_transform {
    compatible = "zmk,matrix-transform";
    columns = <1>;
    rows    = <1>;
    map = <
        RC(0,0)
    >;
  };


}
